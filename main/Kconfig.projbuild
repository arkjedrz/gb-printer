## main/Kconfig.projbuild
```kconfig
menu "gb-printer configuration"

    orsource "$IDF_PATH/examples/common_components/env_caps/$IDF_TARGET/Kconfig.env_caps"

    config GPIO_DETECT
        int "GB connection detect"
        range ENV_GPIO_RANGE_MIN ENV_GPIO_IN_RANGE_MAX
        default 16
        help
            GPIO pin number to be used as GPIO_DETECT.

    config GPIO_TX
        int "Tx - output"
        range ENV_GPIO_RANGE_MIN ENV_GPIO_OUT_RANGE_MAX
        default 4
        help
            GPIO pin number to be used as GPIO_TX.

    config GPIO_RX
        int "Rx - input"
        range ENV_GPIO_RANGE_MIN ENV_GPIO_IN_RANGE_MAX
        default 12
        help
            GPIO pin number to be used as GPIO_RX.

    config GPIO_CLOCK
        int "Clock - input"
        range ENV_GPIO_RANGE_MIN ENV_GPIO_IN_RANGE_MAX
        default 17
        help
            GPIO pin number to be used as GPIO_CLOCK.

    config AP_SSID
        string "Access point SSID"
        default "gb-printer"
        help
            Access point SSID.

    config AP_PASS
        string "Access point password"
        default "gb-printer"
        help
            Access point password (WPA2).

    config WIFI_CHANNEL
        int "Wi-Fi Channel"
        range 1 13
        default 1
        help
            Wi-Fi channel to use.

    config MAX_STA_CONN
        int "Max number of connections"
        default 1
        help
            Max number of allowed connections.

endmenu
```
